#include <Ultrasonic.h> 

#include <Wire.h>
#include <Adafruit_GFX.h>
#include <Adafruit_SSD1306.h>

#include <Adafruit_MLX90614.h>    // Senesor de temperatura

#include <Arduino.h>
#include "DFRobotDFPlayerMini.h"

#include <SoftwareSerial.h>

SoftwareSerial NANO(33,32); //(rx,tx)

// Ultrassonico
unsigned int distancia = 0;
#define PIN_TRIGGER   4
#define PIN_ECHO      5
Ultrasonic ultrasonic(PIN_TRIGGER, PIN_ECHO);

// Display
#define SCREEN_WIDTH 128
#define SCREEN_HEIGHT 64
Adafruit_SSD1306 display(SCREEN_WIDTH, SCREEN_HEIGHT, &Wire, -1);

// Sensor de temperatura
Adafruit_MLX90614 mlx = Adafruit_MLX90614();
float amb, corp = 0;

// DFmp3 
HardwareSerial mySoftwareSerial(1); // UART1 (0), UART2 (1), UART3 (2).
DFRobotDFPlayerMini myDFPlayer; // Cria a variável "myDFPlayer"

// Variaveis e constantes

#define TOTAL_PESSOAS 50000 // usado na função total_Pessos
int q = 0; // usado na função total_Pessos

int cont = 0; // para o loop da função animação
unsigned long t = 0;  // para o loop da função animação

float media_temperatura = 0; // para a função sensor temp

bool lotado = false; // para função total_Pessoas e T_ambiente_lotado

// Imagens para o Display
const unsigned char IF [] PROGMEM = {
  0xff, 0xff, 0xff, 0xff, 0xff, 0xff, 0xff, 0xff, 0xff, 0xff, 0xff, 0xff, 0xff, 0xff, 0xff, 0xff, 
  0xff, 0xff, 0xff, 0xff, 0xff, 0xff, 0xff, 0xff, 0xff, 0xff, 0xff, 0xff, 0xff, 0xff, 0xff, 0xff, 
  0xff, 0xff, 0xff, 0xff, 0xff, 0xff, 0xff, 0xff, 0xff, 0xff, 0xff, 0xff, 0xff, 0xff, 0xff, 0xff, 
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  0xff, 0xff, 0xff, 0xff, 0xff, 0xff, 0xff, 0xff, 0xff, 0xff, 0xff, 0xff, 0xff, 0xff, 0xff, 0xff
};
bool interrompe_inicia = 0;

// VARIAVEIS DE COMUNICAÇÃO ENTRE NANO E ESP




void setup(){
  Serial.begin(115200);    
  NANO.begin(115200);            
  inicia_Tudo();
  intro();
}



bool desabilita_termometro = 0;
unsigned long tempo_delay = 0;
bool t_bounce = 1;


void loop(){

if(Serial.available()!=0) {
  char l = Serial.read();
  if(l == 's'){
    interrompe_inicia = 1;   // STOP
  }

  if(l == 'S'){
    interrompe_inicia = 0;  // START
  }

  if(l == 'm'){
    total_Pessoas(0);
  }

  if(l == 'z'){
    q = 0;
  }

  if(l == 'y'){  // desabilita termometro
    desabilita_termometro = 1;
    interrompe_inicia = 1;   // STOP
  }
  if(l == 'x'){  // habilita termometro
    desabilita_termometro = 0;
    interrompe_inicia = 0;   // START
  }
  
}

if(interrompe_inicia == 0){         // funiconamento padrão
    
    if (sensor_Dist(0) < 10 && sensor_Dist(0) > 6){
      if (lotado == false){
        T_aproximar();
      }
      else{
       // T_ambiente_lotado();
      }
    }
    
    if (sensor_Dist(0) < 6 && sensor_Dist(0) >= 2){
      if (lotado == false){
            for(byte x = 1; x<=10; x++)
          {  media_temperatura += sensor_Temp();}
          
          media_temperatura = media_temperatura/10;
          
          if(media_temperatura > 34 && media_temperatura < 37.5){
            Serial.write('M');    // pessoa no estabelecimento
            delay(50);
            if(media_temperatura > 34 && media_temperatura < 35)Serial.write('q'); //34ºC
            if(media_temperatura > 35 && media_temperatura < 36)Serial.write('w'); //35ºC
            if(media_temperatura > 36 && media_temperatura < 37)Serial.write('e'); //36ºC
            if(media_temperatura > 37 && media_temperatura < 37.5)Serial.write('r'); //37ºC
            T_normal(); 
            
           // T_prosseguir();
            Serial.write('S');  // pessoa que entraram no estabelecimento
            delay(50);
            Serial.write('T');  // TOTAL DE PESSOAS AFERIDAS
            total_Pessoas(1);
          }
          if (media_temperatura > 37.5){
            T_febre();
            Serial.write('f');
            delay(50);
            Serial.write('T');  // TOTAL DE PESSOAS AFERIDAS
            T_ajuda_medica();
          }
          delay(1000);
          media_temperatura = 0;
      }
      else{
        T_ambiente_lotado();
      }
      
      
    }


    if (millis()-t > 200){
    cont++;
    animation(cont);
    if (cont ==6) cont = 0; 
    t = millis();
  }
    
}




if(desabilita_termometro == 1){         // funiconamento sem termometro
    
    if (sensor_Dist(0) < 10 && sensor_Dist(0) > 2){
      if (lotado == false){
        T_aproximar();
        if(t_bounce == 1){
          tempo_delay = millis();
          t_bounce = 0;
        }
        
        if (millis()-tempo_delay > 100){
            tempo_delay = millis();
             Serial.write('M');    // pessoa no estabelecimento
             delay(50);
             Serial.write('T');
             delay(50);
             total_Pessoas(1);
        }
        
      }
      
      else{
        t_bounce = 1;
        T_ambiente_lotado();
      }

      
    }
    
   

    if (millis()-t > 200){
    cont++;
    animation(cont);
    if (cont ==6) cont = 0; 
    t = millis();
  }
    
}
  
  
  
}
